## package/llvm-project/llvm/Config.in
```kconfig
config BR2_PACKAGE_LLVM_ARCH_SUPPORTS
	bool
	default y if BR2_i386
	default y if BR2_x86_64
	default y if BR2_aarch64
	default y if BR2_arm || BR2_armeb
	default y if BR2_riscv
	default y if BR2_mips || BR2_mipsel
	default y if BR2_mips64 || BR2_mips64el

	# mips        - MIPS (32-bit big endian)
	# mips64      - MIPS (64-bit big endian)
	# mips64el    - MIPS (64-bit little endian)
	# mipsel      - MIPS (32-bit little endian)

config BR2_PACKAGE_LLVM_TARGET_ARCH
	string
	default "AArch64" if BR2_aarch64
	default "ARM" if BR2_arm || BR2_armeb
	default "X86" if BR2_i386 || BR2_x86_64
	default "riscv32" if BR2_riscv && !BR2_ARCH_IS_64
	default "riscv64" if BR2_riscv && BR2_ARCH_IS_64
	default "X86" if BR2_i386 || BR2_x86_64
	# TODO: is this correct?
	# https://github.com/sabotage-linux/sabotage/blob/1c2a019435af6ab23370ed356d41b219e042092e/pkg/llvm-clang601#L92
	# https://github.com/LeSpocky/ptxdist/blob/8b4232c8d76fccd51e7338379f449add3183f0b9/rules/llvm.make#L53
	default "Mips" if BR2_mips || BR2_mipsel || BR2_mips64 || BR2_mips64el

config BR2_PACKAGE_LLVM
	bool "llvm"
	# TODO: this OR BPF?
	depends on BR2_PACKAGE_LLVM_ARCH_SUPPORTS
	depends on BR2_TOOLCHAIN_GCC_AT_LEAST_7
	depends on BR2_TOOLCHAIN_HAS_THREADS
	depends on BR2_INSTALL_LIBSTDCPP
	depends on !BR2_TOOLCHAIN_HAS_GCC_BUG_64735 # std::shared_future
	depends on !BR2_STATIC_LIBS
	depends on BR2_USE_WCHAR # std::wstring
	depends on BR2_HOST_GCC_AT_LEAST_7 # host-llvm
	select BR2_HOST_CMAKE_AT_LEAST_3_20 # cmake required version at least 3.20
	help
	  The LLVM Project is a collection of modular and reusable
	  compiler and toolchain technologies.

	  http://llvm.org

if BR2_PACKAGE_LLVM

config BR2_PACKAGE_LLVM_AMDGPU
	bool "AMDGPU backend"
	help
	  Build AMDGPU target. Select this option if you are going
	  to install mesa3d with llvm and use Gallium Radeon driver.

config BR2_PACKAGE_LLVM_RTTI
	bool "enable rtti"
	help
	  Build LLVM with run-time type information. LLVM can be built
	  without rtti, but turning it off changes the ABI of C++
	  programs.

	  This features is needed to build the Gallium Nouveau driver
	  or the Clover OpenCL state tracker when llvm support is
	  enabled.

	  https://llvm.org/docs/HowToSetUpLLVMStyleRTTI.html

config BR2_PACKAGE_LLVM_BPF
	bool "BPF backend"
	help
	  Build BPF target. Select this option if you are going
	  to install bcc on the target.

config BR2_PACKAGE_LLVM_DUMP
	bool "enable dump"
	help
	  Build LLVM with dump functions even when assertions are
	  disabled.

endif

comment "llvm needs a toolchain w/ wchar, threads, C++, gcc >= 7, dynamic library, host gcc >= 7"
	depends on BR2_PACKAGE_LLVM_ARCH_SUPPORTS
	depends on !BR2_TOOLCHAIN_HAS_THREADS || !BR2_INSTALL_LIBSTDCPP || \
		!BR2_TOOLCHAIN_GCC_AT_LEAST_7 \
		|| BR2_STATIC_LIBS || !BR2_USE_WCHAR \
		|| !BR2_HOST_GCC_AT_LEAST_7

comment "llvm needs a toolchain not affected by GCC bug 64735"
	depends on BR2_PACKAGE_LLVM_ARCH_SUPPORTS
	depends on BR2_TOOLCHAIN_HAS_GCC_BUG_64735
```

## package/xdp-tools/Config.in
```kconfig
config BR2_PACKAGE_XDP_TOOLS
        bool "xdp-tools"
        depends on BR2_PACKAGE_LIBBPF
        select BR2_PACKAGE_LIBCAP_NG
        select BR2_PACKAGE_LIBPCAP
        help
          xdp-tools contains a collection of utilities and example code that
          uses the libxdp library for working with the eXpress Data Path
          facility of the Linux kernel.

          https://github.com/xdp-project/xdp-tools
```
